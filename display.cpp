#include "display.h"
#include <Preferences.h>

// ============================================================
//  LOGO BITMAP DEFAULT (PROGMEM)
// ============================================================
static const unsigned char epd_bitmap_Logo_Polindra[] PROGMEM = {
  0x00, 0x00, 0x00, 0x00, 0x00, 0x00, 0x00, 0x00, 0x00, 0x00, 0x00, 0x00, 0x00, 0x00, 0x00, 0x00,
  0x00, 0x00, 0x00, 0x00, 0x00, 0x00, 0x00, 0x00, 0x00, 0x00, 0x00, 0x00, 0x00, 0x00, 0x00, 0x00,
  0x00, 0x00, 0x00, 0x00, 0x00, 0x00, 0x00, 0x00, 0x00, 0x00, 0x00, 0x00, 0x00, 0x00, 0x00, 0x00,
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  0x00, 0x00, 0x00, 0x00, 0x00, 0x00, 0x00, 0x07, 0xe0, 0x00, 0x00, 0x00, 0x00, 0x00, 0x00, 0x00
};

// ============================================================
//  GLOBAL INSTANCES
// ============================================================
static Adafruit_SSD1306 display(SCREEN_WIDTH, SCREEN_HEIGHT, &Wire, OLED_RESET);
static Preferences      dispPrefs;

// Custom bitmap buffer (1KB di RAM)
static uint8_t customBitmapBuf[1024];
static bool    customBitmapLoaded = false;

DisplayConfig displayConfig = {
  255,   // brightness
  255,   // contrast
  0,     // displayMode
  5000,  // displayTimeout
  2,     // fontSize
  500,   // updateRate
  false  // customLogo
};

// ============================================================
//  SETUP
//  Default boot screen: tampilkan IP WebServer.
//  Jika ada custom logo → logo di area atas (48px),
//  IP di area bawah (16px).
// ============================================================
bool displaySetup(const String& ipAddress) {
  loadCustomBitmap();

  if (!display.begin(SSD1306_SWITCHCAPVCC, SCREEN_ADDRESS)) {
    Serial.println(F("[DISPLAY] SSD1306 init failed"));
    return false;
  }

  showIP(ipAddress);
  return true;
}

// ============================================================
//  SHOW IP — layar default saat boot
//
//  Layout (128×64):
//  ┌──────────────────────────────┐
//  │  [logo 48px tinggi jika ada] │
//  │  atau kosong jika tidak ada  │
//  ├──────────────────────────────┤  y=48
//  │  WiFi: WIRAGORA_2024         │  ukuran 1
//  │  192.168.4.1                 │  ukuran 1
//  └──────────────────────────────┘
// ============================================================
void showIP(const String& ipAddress) {
  display.clearDisplay();
  display.setTextColor(SSD1306_WHITE);

  if (customBitmapLoaded) {
    // Logo custom di area atas (48px dari 64px total)
    // Bitmap di-crop vertikal — hanya 48 baris pertama ditampilkan
    display.drawBitmap(0, 0, customBitmapBuf, 128, 48, SSD1306_WHITE);
  }

  // Garis pemisah
  display.drawFastHLine(0, 49, 128, SSD1306_WHITE);

  // Teks IP di bawah
  display.setTextSize(1);
  display.setCursor(0, 52);
  display.print(F("WiFi: WIRAGORA_2024"));
  display.setCursor(20, 56); // sedikit indent agar terlihat rapi
  // IP di baris terakhir dengan sedikit lebih besar
  display.setTextSize(1);
  display.setCursor(0, 56);
  display.print(ipAddress);

  display.display();
}

// ============================================================
//  SHOW LOGO — static, tidak ada scroll
//  Dipanggil dari tombol SELECT PS3
// ============================================================
void showLogo() {
  display.clearDisplay();
  if (customBitmapLoaded) {
    display.drawBitmap(0, 0, customBitmapBuf, 128, 64, SSD1306_WHITE);
  } else {
    display.drawBitmap(0, 0, epd_bitmap_Logo_Polindra, 128, 64, SSD1306_WHITE);
  }
  display.display();
}

// ============================================================
//  SHOW BATT STATUS
// ============================================================
static void drawBatteryIndicator(int level) {
  display.drawRect(90, 0, 30, 15, SSD1306_WHITE);
  display.fillRect(120, 4, 3, 7, SSD1306_WHITE);
  int width = map(level, 0, 100, 0, 28);
  display.fillRect(91, 1, width, 13, SSD1306_WHITE);
}

void showBattStatus(int battLevel, const String& battMessage) {
  display.clearDisplay();
  display.setTextColor(SSD1306_WHITE);
  display.setTextSize(2);
  display.setCursor(0, 0);
  display.println(F("Battery PS3:"));
  display.setTextSize(1);
  display.setCursor(30, 30);
  display.println(battMessage);
  drawBatteryIndicator(battLevel);
  display.display();
}

// ============================================================
//  SHOW E-STOP
// ============================================================
void showEStop(bool active) {
  display.clearDisplay();
  if (active) {
    display.drawRect(0, 0, 128, 64, SSD1306_WHITE);
    display.drawRect(2, 2, 124, 60, SSD1306_WHITE);
    display.setTextColor(SSD1306_WHITE);
    display.setTextSize(3);
    display.setCursor(10, 8);
    display.println(F("E-STOP"));
    display.setTextSize(1);
    display.setCursor(8, 48);
    display.println(F("Gerak stick = resume"));
  }
  display.display();
}

// ============================================================
//  CONFIG PERSISTENCE
// ============================================================
void loadDisplayConfig() {
  dispPrefs.begin("disp_cfg", true);
  displayConfig.brightness     = dispPrefs.getInt("brightness",     255);
  displayConfig.contrast       = dispPrefs.getInt("contrast",       255);
  displayConfig.displayMode    = dispPrefs.getInt("displayMode",    0);
  displayConfig.displayTimeout = dispPrefs.getInt("displayTimeout", 5000);
  displayConfig.fontSize       = dispPrefs.getInt("fontSize",       2);
  displayConfig.updateRate     = dispPrefs.getInt("updateRate",     500);
  dispPrefs.end();
}

void saveDisplayConfig() {
  dispPrefs.begin("disp_cfg", false);
  dispPrefs.putInt("brightness",     displayConfig.brightness);
  dispPrefs.putInt("contrast",       displayConfig.contrast);
  dispPrefs.putInt("displayMode",    displayConfig.displayMode);
  dispPrefs.putInt("displayTimeout", displayConfig.displayTimeout);
  dispPrefs.putInt("fontSize",       displayConfig.fontSize);
  dispPrefs.putInt("updateRate",     displayConfig.updateRate);
  dispPrefs.end();
}

// ============================================================
//  CUSTOM BITMAP — SAVE & LOAD
// ============================================================
static const char b64chars[] =
  "ABCDEFGHIJKLMNOPQRSTUVWXYZabcdefghijklmnopqrstuvwxyz0123456789+/";

static int b64val(char c) {
  const char* p = strchr(b64chars, c);
  return p ? (int)(p - b64chars) : -1;
}

bool saveBitmapToPrefs(const String& b64) {
  if (b64.length() < 100 || b64.length() > 2000) return false;

  static uint8_t raw[1200];
  int outLen = 0;
  for (int i = 0; i < (int)b64.length() - 3 && outLen < 1200; i += 4) {
    int a = b64val(b64[i]),   b = b64val(b64[i+1]);
    int c = b64val(b64[i+2]), d = b64val(b64[i+3]);
    if (a < 0 || b < 0) break;
    raw[outLen++] = (a << 2) | (b >> 4);
    if (c >= 0) raw[outLen++] = (b << 4) | (c >> 2);
    if (d >= 0) raw[outLen++] = (c << 6) | d;
  }

  // Validasi BMP magic bytes
  if (raw[0] != 0x42 || raw[1] != 0x4D) return false;

  // Offset pixel data dari BMP header
  int pixelOffset = raw[10] | (raw[11] << 8) | (raw[12] << 16) | (raw[13] << 24);
  if (pixelOffset + 1024 > outLen) return false;

  Preferences p;
  p.begin("logo_cfg", false);
  p.putBytes("bmp", raw + pixelOffset, 1024);
  p.end();

  memcpy(customBitmapBuf, raw + pixelOffset, 1024);
  customBitmapLoaded        = true;
  displayConfig.customLogo  = true;
  return true;
}

void loadCustomBitmap() {
  Preferences p;
  p.begin("logo_cfg", true);
  size_t len = p.getBytesLength("bmp");
  if (len == 1024) {
    p.getBytes("bmp", customBitmapBuf, 1024);
    customBitmapLoaded = true;
  }
  p.end();
}